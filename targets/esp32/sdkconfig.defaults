## targets/esp32/sdkconfig.defaults
```kconfig
# ESP-IDF v6.0 Configuration for CSpot on ESP32 (Lolin D32 Pro)
# Device: 16MB Flash, 8MB PSRAM

#
# Chip configuration
#
CONFIG_IDF_TARGET="esp32"
CONFIG_IDF_TARGET_ESP32=y

#
# Build type
#
CONFIG_APP_BUILD_TYPE_APP_2NDBOOT=y

#
# Serial flasher config
#
CONFIG_ESPTOOLPY_FLASHMODE_DIO=y
CONFIG_ESPTOOLPY_FLASHFREQ_40M=y
CONFIG_ESPTOOLPY_FLASHSIZE_16MB=y
CONFIG_PARTITION_TABLE_CUSTOM=y
CONFIG_PARTITION_TABLE_CUSTOM_FILENAME="partitions.csv"

#
# Bootloader config
#
CONFIG_BOOTLOADER_LOG_LEVEL_INFO=y

#
# Security features
#
# CONFIG_SECURE_BOOT is not set
# CONFIG_SECURE_FLASH_ENC_ENABLED is not set

#
# Memory & PSRAM
#
CONFIG_ESP32_SPIRAM_SUPPORT=y
CONFIG_SPIRAM_MODE_QUAD=y
CONFIG_SPIRAM_TYPE_AUTO=y
CONFIG_SPIRAM_SIZE_AUTO=y

#
# Wi-Fi
#
CONFIG_ESP_WIFI_DYNAMIC_RX_BUFFER_NUM=32
CONFIG_ESP_WIFI_DYNAMIC_TX_BUFFER_NUM=32
CONFIG_ESP_WIFI_TX_AMPDU_BUF_NUM=16

#
# I2S Audio
#
CONFIG_ESP_I2S_ENABLE_DEBUG_LOG=n

#
# Logging
#
CONFIG_LOG_DEFAULT_LEVEL_INFO=y
CONFIG_LOG_DEFAULT_LEVEL=3

#
# SPIFFS
#
CONFIG_ESP_SPIFFS_USES_METALNX=y

#
# Application manager
#
CONFIG_APP_COMPILE_TIME_DATE=y

#
# Wi-Fi Provisioning
#
CONFIG_WIFI_PROV_ENABLE_BLE=y

#
# mDNS
#
CONFIG_MDNS_ENABLE_IPV6=y

#
# mbedTLS
#
CONFIG_MBEDTLS_PSA_CRYPTO_CLIENT=y
```
